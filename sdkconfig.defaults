## sdkconfig.defaults
```kconfig
CONFIG_PARTITION_TABLE_SINGLE_APP_LARGE=y
CONFIG_PARTITION_TABLE_FILENAME="partitions_singleapp_large.csv"
CONFIG_I2C_ENABLE_SLAVE_DRIVER_VERSION_2=y
CONFIG_ESP_MAIN_TASK_STACK_SIZE=14336
CONFIG_FREERTOS_CHECK_STACKOVERFLOW_PTRVAL=y
CONFIG_FREERTOS_WATCHPOINT_END_OF_STACK=y
CONFIG_MAIN_TASK_STACK_SIZE=14336

# from generic_lcd/sdkconfig.default
CONFIG_FREERTOS_HZ=1000

CONFIG_LIBC_NEWLIB=y

CONFIG_MONITOR_BAUD=115200

# CONFIG_BOOTLOADER_COMPILER_OPTIMIZATION_SIZE=y
# CONFIG_BOOTLOADER_COMPILER_OPTIMIZATION_DEBUG is not set
CONFIG_BOOTLOADER_COMPILER_OPTIMIZATION_PERF=y

#CONFIG_LOG_DEFAULT_LEVEL_DEBUG=y
#CONFIG_LOG_DEFAULT_LEVEL=4
#CONFIG_LOG_MAXIMUM_EQUALS_DEFAULT=y
#CONFIG_LOG_MAXIMUM_LEVEL=4

CONFIG_LOG_DEFAULT_LEVEL_INFO=y
CONFIG_LOG_DEFAULT_LEVEL=3
CONFIG_LOG_MAXIMUM_EQUALS_DEFAULT=y
CONFIG_LOG_MAXIMUM_LEVEL=3
```
